## conf/layer.conf
```bitbake
# We have a conf and classes directory, add to BBPATH
BBPATH .= ":${LAYERDIR}"

# We have recipes-* directories, add to BBFILES
BBFILES += "${LAYERDIR}/recipes-*/*/*.bb \
            ${LAYERDIR}/recipes-*/*/*.bbappend"

BBFILE_COLLECTIONS += "meta-gardena"
BBFILE_PATTERN_meta-gardena = "^${LAYERDIR}/"
BBFILE_PRIORITY_meta-gardena = "40"

LAYERSERIES_COMPAT_meta-gardena = "dunfell"
```
